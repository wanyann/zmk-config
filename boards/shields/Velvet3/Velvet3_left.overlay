#include "Velvet3.dtsi"

&kscan0 {
    col-gpios
        = <&gpio0 12 GPIO_ACTIVE_HIGH>
        , <&gpio1 9 GPIO_ACTIVE_HIGH>
        , <&gpio0 8 GPIO_ACTIVE_HIGH>
        , <&gpio0 6 GPIO_ACTIVE_HIGH>
        , <&gpio0 26 GPIO_ACTIVE_HIGH>
        , <&gpio0 31 GPIO_ACTIVE_HIGH>
        ;
};

&left_encoder {
    status = "okay";
};
