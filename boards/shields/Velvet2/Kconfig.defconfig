## boards/shields/Velvet2/Kconfig.defconfig
```kconfig
if SHIELD_VELVET2_LEFT

config ZMK_KEYBOARD_NAME
    default "EH Velvet2"

config ZMK_SPLIT_ROLE_CENTRAL
    default y

endif

if SHIELD_VELVET2_LEFT || SHIELD_VELVET2_RIGHT

config ZMK_SPLIT
    default y

endif
```

## boards/shields/Velvet3/Kconfig.shield
```kconfig
config SHIELD_VELVET3_LEFT
    def_bool $(shields_list_contains,Velvet3_left)

config SHIELD_VELVET3_RIGHT
    def_bool $(shields_list_contains,Velvet3_right)
```

## boards/shields/blue-velvet/Kconfig.defconfig
```kconfig
if SHIELD_BLUE-VELVET_LEFT

config ZMK_KEYBOARD_NAME
    default "Blue-velvet"

config ZMK_SPLIT_ROLE_CENTRAL
    default y

endif

if SHIELD_BLUE-VELVET_LEFT || SHIELD_BLUE-VELVET_RIGHT

config ZMK_SPLIT
    default y

endif
```

## boards/shields/blue-velvet/Kconfig.shield
```kconfig
config SHIELD_BLUE-VELVET_LEFT
    def_bool $(shields_list_contains,blue-velvet_left)

config SHIELD_BLUE-VELVET_RIGHT
    def_bool $(shields_list_contains,blue-velvet_right)
```

## config/boards/shields/Velvet2/Kconfig.shield
```kconfig
config SHIELD_VELVET2_LEFT
    def_bool $(shields_list_contains,Velvet2_left)

config SHIELD_VELVET2_RIGHT
    def_bool $(shields_list_contains,Velvet2_right)
```

## config/boards/shields/Velvet3/Kconfig.defconfig
```kconfig
if SHIELD_VELVET3_LEFT

config ZMK_KEYBOARD_NAME
    default "EH Velvet v3"

config ZMK_SPLIT_ROLE_CENTRAL
    default y

endif

if SHIELD_VELVET3_LEFT || SHIELD_VELVET3_RIGHT

config ZMK_SPLIT
    default y

endif
```

## config/boards/shields/op36/Kconfig.shield
```kconfig
config SHIELD_OP36_LEFT
    def_bool $(shields_list_contains,Velvet3_left)

config SHIELD_OP36_RIGHT
    def_bool $(shields_list_contains,Velvet3_right)
```

## config/boards/shields/velvet_v3/Kconfig.shield
```kconfig
config SHIELD_VELVET_V3_LEFT
    def_bool $(shields_list_contains,velvet3_left)

config SHIELD_VELVET_V3_RIGHT
    def_bool $(shields_list_contains,velvet3_right)
```

## config/west.yml
```yaml
manifest:
  remotes:
    - name: zmkfirmware
      url-base: https://github.com/zmkfirmware
    - name: custom
      url-base: https://github.com/danil-tolkachev
    # Additional modules containing boards/shields/custom code can be listed here as well
    # See https://docs.zephyrproject.org/3.2.0/develop/west/manifest.html#projects
    - name: badjeff
      url-base: https://github.com/badjeff
  projects:
    - name: zmk
      remote: custom
      revision: main
      import: app/west.yml
    - name: zmk-pmw3610-driver
      remote: badjeff
      revision: main
  self:
    path: config
```
